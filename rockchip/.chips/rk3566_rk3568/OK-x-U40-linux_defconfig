## rockchip/.chips/rk3566_rk3568/amp_linux.its
```
/* SPDX-License-Identifier: BSD-3-Clause */
/*
 * Copyright (c) 2023 Rockchip Electronics Co., Ltd.
 */

/dts-v1/;
/ {
	description = "FIT source file for rockchip AMP";
	#address-cells = <1>;

	images {
		amp1 {
			description  = "bare-metal-core1";
			data         = /incbin/("hal1.bin");
			type         = "firmware";
			compression  = "none";
			arch         = "arm";
			cpu          = <0x100>;
			thumb        = <0>;
			hyp          = <0>;
			load         = <0x02400000>;
			compile {
				size     = <0x00200000>;
				sys      = "hal";
				core     = "ap";
			};
			udelay       = <1000000>;
			hash {
				algo = "sha256";
			};
		};

		amp2 {
			description  = "bare-metal-core2";
			data         = /incbin/("hal2.bin");
			type         = "firmware";
			compression  = "none";
			arch         = "arm";
			cpu          = <0x200>;
			thumb        = <0>;
			hyp          = <0>;
			load         = <0x02600000>;
			compile {
				size     = <0x00200000>;
				sys      = "hal";
				core     = "ap";
			};
			udelay       = <1000000>;
			hash {
				algo = "sha256";
			};
		};

		amp3 {
			description  = "bare-metal-core3";
			data         = /incbin/("hal3.bin");
			type         = "firmware";
			compression  = "none";
			arch         = "arm";
			cpu          = <0x300>;
			thumb        = <0>;
			hyp          = <0>;
			load         = <0x02800000>;
			compile {
				size     = <0x00200000>;
				sys      = "hal";
				core     = "ap";
			};
			udelay       = <1000000>;
			hash {
				algo = "sha256";
			};
		};
	};

	configurations {
		default = "conf";
		conf {
			description = "Rockchip AMP images";
			rollback-index = <0x0>;
			loadables = "amp1", "amp2", "amp3";

			signature {
				algo = "sha256,rsa2048";
				padding = "pss";
				key-name-hint = "dev";
				sign-images = "loadables";
			};

			/* - run linux on cpu0
			 * - it is brought up by amp(that run on U-Boot)
			 * - it is boot entry depends on U-Boot
			 */
			linux {
				description  = "linux-os";
				arch         = "arm64";
				cpu          = <0x000>;
				thumb        = <0>;
				hyp          = <0>;
				udelay       = <0>;
				load         = <0x03880000>;
				load_c       = <0x04080000>;
			};
		};
	};
};
```

## rockchip/.chips/rk3566_rk3568/amp_linux_3576.its
```
/* SPDX-License-Identifier: BSD-3-Clause */
/*
 * Copyright (c) 2023 Rockchip Electronics Co., Ltd.
 */

/dts-v1/;
/ {
	description = "FIT source file for rockchip AMP";
	#address-cells = <1>;

	images {
		amp3 {
			description  = "rtos-core3";
			data         = /incbin/("cpu3.bin");
			type         = "firmware";
			compression  = "none";
			arch         = "arm64";
			cpu          = <0x003>;
			thumb        = <0>;
			hyp          = <0>;
			load         = <0x41800000>;
			compile {
				size         = <0x00800000>;
				srambase     = <0x3ff80000>;
				sramsize     = <0x00080000>;
				sys      = "rtt";
				core     = "ap";
				rtt_config   = "board/rk3576_evb1/defconfig"
				rtt_exec     = "prebuilts/gcc/linux-x86/aarch64/arm-gnu-toolchain-13.2.Rel1-x86_64-aarch64-none-elf/bin"
				cc           = "prebuilts/gcc/linux-x86/aarch64/arm-gnu-toolchain-13.2.Rel1-x86_64-aarch64-none-elf/bin/aarch64-none-elf-"
			};
			udelay       = <10000>;
			hash {
				algo = "sha256";
			};
		};
	};

	ext_memory {
		shm_base        = <0x47900000>;
		shm_size        = <0x00400000>;
		rpmsg_base      = <0x47d00000>;
		rpmsg_size      = <0x00400000>;
	};

	configurations {
		default = "conf";
		conf {
			description = "Rockchip AMP images";
			rollback-index = <0x0>;
			loadables = "amp3";

			signature {
				algo = "sha256,rsa2048";
				padding = "pss";
				key-name-hint = "dev";
				sign-images = "loadables";
			};

			/* - run linux on cpu0
			 * - it is brought up by amp(that run on U-Boot)
			 * - it is boot entry depends on U-Boot
			 */
			linux {
				description  = "linux-os";
				arch         = "arm64";
				cpu          = <0x000>;
				thumb        = <0>;
				hyp          = <0>;
				udelay       = <0>;
				load         = <0x42100000>;
				load_c       = <0x45480000>;
			};
		};
	};
};
```
